    {"effects/audio/glow.mle", 0xded139de73aad7efull},
    {"effects/audio/pulse.mle", 0xcfa5b1d85be98998ull},
    {"effects/audio/spectrum.mle", 0xba428f684216ecbeull},
    {"effects/basics/breathe.mle", 0xc264f7b683c94cceull},
    {"effects/basics/chase.mle", 0xc338158f7b9f20d6ull},
    {"effects/basics/crosshair.mle", 0x1ecd2d5ba648e680ull},
    {"effects/basics/dot.mle", 0x1e5cd842f29bd16cull},
    {"effects/basics/gradient.mle", 0x066b6e80d9fb84cbull},
    {"effects/basics/lines.mle", 0x61a519a99d69b4c6ull},
    {"effects/basics/ramp.mle", 0x56270ce14f72fa1full},
    {"effects/basics/random-pixel.mle", 0xf7fb12703b9df7e6ull},
    {"effects/basics/sparkle.mle", 0x6ea5f2562ef2cd4full},
    {"effects/moving-heads/mh-aim.mle", 0xa3b9705009ee6730ull},
    {"effects/moving-heads/mh-ambient.mle", 0xf5170dcf140e2204ull},
    {"effects/moving-heads/mh-sweep.mle", 0x9b60fb840efbcda6ull},
    {"effects/moving-heads/mh-troy.mle", 0xf14ce04a1093b98eull},
    {"effects/moving-heads/mh-wowi.mle", 0x2d5344bf6451948eull},
    {"effects/particles/ballpit.mle", 0x7b3066f771f2b0b6ull},
    {"effects/particles/balls.mle", 0xbb5164cdbc9212c2ull},
    {"effects/particles/comet-trail.mle", 0xf32055d6b321a624ull},
    {"effects/particles/ember.mle", 0xfdbae5798bfc5166ull},
    {"effects/particles/fountain.mle", 0x82dfa1dfc065e39full},
    {"effects/particles/rain.mle", 0xaa0219b0eb71cf4eull},
    {"effects/shaders/fluid.mle", 0xae90b7a03c897817ull},
    {"effects/shaders/fractal.mle", 0x030ffee2720ea938ull},
    {"effects/shaders/metal.mle", 0x74653c8d7f09b748ull},
    {"effects/shaders/nebula.mle", 0x6248d83646fad1f3ull},
    {"effects/shaders/trails.mle", 0x7df2e1c3f6a5eeb6ull},
    {"effects/waves/aurora.mle", 0x996cd3f22e4dc197ull},
    {"effects/waves/noise.mle", 0x59d7fc331c86f6b0ull},
    {"effects/waves/octopus.mle", 0x547abd2e1fc5e611ull},
    {"effects/waves/plasma.mle", 0xcf6d241a11a3f985ull},
    {"effects/waves/ripples.mle", 0x9b9f9be80e1e0c61ull},
    {"layouts/backlight.mll", 0x8fb9b3dac83279edull},
    {"layouts/diagonal.mll", 0x8d903da3498de21aull},
    {"layouts/grid.mll", 0x19ba4f6c02fbec77ull},
    {"layouts/lattice.mll", 0xbf932d2667cc1e2bull},
    {"layouts/lightcrafter16.mll", 0x88b21fa19926d0baull},
    {"layouts/reversed-row.mll", 0x785717443ed98909ull},
    {"layouts/ring.mll", 0xff6ea124f4984df7ull},
    {"layouts/rose.mll", 0xaaa163ddfd7f7582ull},
    {"layouts/se16.mll", 0xb3d61a600c981e77ull},
    {"layouts/sixteen-rings.mll", 0x2be3763b705091acull},
    {"layouts/two-rows.mll", 0x87d0dc459e897bf6ull},
    {"modifiers/mirror.mlm", 0x72dcbfe7e1304111ull},
    {"modifiers/shift.mlm", 0xd8b0753f0d8df134ull},
    {"modifiers/transpose.mlm", 0x4c7cb92f54e87418ull},
    {"palettes/beat-flash.mlp", 0x2bddbddeecf452d6ull},
    {"palettes/drift.mlp", 0x431d765e3fcc25abull},
    {"palettes/fire.mlp", 0x1acffb6bb6322e64ull},
    {"palettes/spectrum.mlp", 0x44d8cd5c43b0500eull},
    {"palettes/temperature.mlp", 0x98bf482549960c5full},
    {"projects/hpwit/edge-comets.mle", 0x770e1191690f4ee8ull},
    {"projects/hpwit/fire.mle", 0x762be27986c8668aull},
    {"projects/hpwit/hpwit-show.mls", 0xda9c200553fc3687ull},
    {"projects/hpwit/mandala.mle", 0x2f9966d05801230eull},
    {"projects/hpwit/particle-fountain.mle", 0x99ba29954a9ee1ecull},
    {"projects/hpwit/plasma-ring.mle", 0x3e4ae542352cd91cull},
    {"projects/hpwit/plasma-wander.mle", 0x6c42e11998417a82ull},
    {"projects/hpwit/ripple-rings.mle", 0x76207732c0dc3e0cull},
    {"projects/hpwit/spinning-squares.mle", 0x858b8669a04442b6ull},
    {"projects/hpwit/twinkle-stars.mle", 0xce710a52c95fef72ull},
    {"projects/hpwit/voronoi.mle", 0x7dda90571519a6fcull},
    {"projects/stadbeest/stadbeest-autopilot.mls", 0x75b23bcffd079687ull},
    {"projects/stadbeest/stadbeest-eye-orb.mle", 0xfd590905cb2a4e0eull},
    {"projects/stadbeest/stadbeest-fire.mlp", 0x2707ecda19a0abc5ull},
    {"projects/stadbeest/stadbeest-frog-eye.mle", 0x9e1e030206e1a49full},
    {"projects/stadbeest/stadbeest-mouth.mle", 0x52e0471dda27a918ull},
    {"projects/stadbeest/stadbeest-orb.mle", 0xc3cc0b0853ee7d42ull},
    {"projects/stadbeest/stadbeest-sauron.mle", 0xd439b3dd89fa6dccull},
    {"projects/stadbeest/stadbeest-thrusters.mle", 0x234a1e01f7efa8b7ull},
    {"projects/stadbeest/stadbeest-walk.mle", 0x07253f910ca2b12aull},
    {"services/button.mls", 0x377a24ae1d49b9d1ull},
    {"services/chase.mls", 0x91984b68b9521c79ull},
    {"services/jsondemo.mls", 0xe6f44fec9d3bf3b2ull},
    {"services/power.mls", 0x0656e0565392a427ull},
    {"services/sweep.mls", 0xf22d60f9fdbec0ecull},
    {"services/weather.mls", 0xd29c20c5e3c8cb3full},
